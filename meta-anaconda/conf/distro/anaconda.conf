## meta-anaconda/conf/distro/anaconda.conf
```bitbake
# use systemd as the default init manager
# comment the following lines to use 'sysvinit' as the init manager
VIRTUAL-RUNTIME_init_manager = "systemd"
DISTRO_FEATURES_BACKFILL_CONSIDERED_append = " sysvinit"
DISTRO_FEATURES_append = " systemd"

DISTRO_VERSION = "1.3"

DISTRO_FEATURES_append = " \
    x11 \
    opengl \
    pam \
"

VIRTUAL-RUNTIME_base-utils = "busybox"

KERNEL_CLASSES_append = " anaconda_kernel"

IMAGE_FEATURES_append = " package-management"

# Want ldconfig in the output package
# The python module require it
DISTRO_FEATURES_append = " ldconfig"

# It works for both of syslinux and grub-efi
LABELS_LIVE = "boot"

# Have graphics and serial in the boot menu when use grub-efi in iso
GRUB_GFXSERIAL = "1"

QB_MEM_qemux86-64 = "-m 2048"

HOSTTOOLS_append = " tac"

MACHINE_FEATURES_append = " efi"

UVESA_MODE = "1024x768-32"

PREFERRED_VERSION_python3-pykickstart = "3.26"
PREFERRED_VERSION_python3-langtable = "0.0.54"
GRUB_OPTS_append = ";search --no-floppy --set=root -l 'boot'"

INITRD_IMAGE_LIVE = "${MLPREFIX}core-image-anaconda-initramfs"
```

## meta-bsp/conf/distro/phytium.conf
```bitbake
require conf/distro/poky.conf

DISTRO = "phytium"
DISTRO_NAME = "Phytium SDK (Phy Reference Distro)"

TARGET_VENDOR = "-phy"

SDK_VENDOR = "-physdk"
SDK_NAME_PREFIX = "${DISTRO}"

TOOLCHAIN_OUTPUTNAME = "${DISTRO}-${TCLIBC}-${SDKMACHINE}-${IMAGE_BASENAME}-${TUNE_PKGARCH}-toolchain-${SDK_VERSION}"

DISTRO_FEATURES_append = " x11 opengl virtualization polkit systemd pam"

LICENSE_FLAGS_WHITELIST = "non-commercial_netperf"

DISTRO_FEATURES_BACKFILL_CONSIDERED += "sysvinit"
VIRTUAL-RUNTIME_init_manager = "systemd"

GRUB_OPTS_append = ";search --no-floppy --set=root -l 'boot'"

INITRD = "initramfs.img"

DISTRO_GUI_USER ?= "unpriv-user"

PACKAGE_FEED_URIS = "http://10.10.80.193/packagerepos/release \
                     http://10.10.80.193/packagerepos/updates"
PACKAGE_FEED_BASE_PATHS = "rpm"
PACKAGE_FEED_ARCHS = "all ${MACHINE} ${TUNE_PKGARCH}"
```

## meta-bsp/conf/layer.conf
```bitbake
# We have a conf and classes directory, add to BBPATH
BBPATH .= ":${LAYERDIR}"

# We have a packages directory, add to BBFILES
BBFILES += "${LAYERDIR}/recipes-*/*/*.bb \
            ${LAYERDIR}/recipes-*/*/*.bbappend"

BBFILE_COLLECTIONS += "phytium-layer"
BBFILE_PATTERN_phytium-layer := "^${LAYERDIR}/"
BBFILE_PRIORITY_phytium-layer = "5"
LAYERSERIES_COMPAT_phytium-layer = "dunfell hardknott"

# FIXME: set this to avoid changing all the recipes that use it

BBFILES_DYNAMIC += " \
    aglprofilegraphical:${LAYERDIR}/dynamic-layers/aglprofilegraphical/*/*/*.bb \
    aglprofilegraphical:${LAYERDIR}/dynamic-layers/aglprofilegraphical/*/*/*.bbappend \
    \
    browser-layer:${LAYERDIR}/dynamic-layers/browser-layer/*/*/*.bb \
    browser-layer:${LAYERDIR}/dynamic-layers/browser-layer/*/*/*.bbappend \
    \
    filesystem-layer:${LAYERDIR}/dynamic-layers/filesystem-layer/*/*/*.bb \
    filesystem-layer:${LAYERDIR}/dynamic-layers/filesystem-layer/*/*/*.bbappend \
    \
    ivi:${LAYERDIR}/dynamic-layers/ivi/*/*/*.bb \
    ivi:${LAYERDIR}/dynamic-layers/ivi/*/*/*.bbappend \
    \
    networking-layer:${LAYERDIR}/dynamic-layers/networking-layer/*/*/*.bb \
    networking-layer:${LAYERDIR}/dynamic-layers/networking-layer/*/*/*.bbappend \
    \
    openembedded-layer:${LAYERDIR}/dynamic-layers/openembedded-layer/*/*/*.bb \
    openembedded-layer:${LAYERDIR}/dynamic-layers/openembedded-layer/*/*/*.bbappend \
    \
    qt4-layer:${LAYERDIR}/dynamic-layers/qt4-layer/*/*/*.bb \
    qt4-layer:${LAYERDIR}/dynamic-layers/qt4-layer/*/*/*.bbappend \
    \
    qt5-layer:${LAYERDIR}/dynamic-layers/qt5-layer/*/*/*.bb \
    qt5-layer:${LAYERDIR}/dynamic-layers/qt5-layer/*/*/*.bbappend \
    \
    virtualization-layer:${LAYERDIR}/dynamic-layers/virtualization-layer/*/*/*.bb \
    virtualization-layer:${LAYERDIR}/dynamic-layers/virtualization-layer/*/*/*.bbappend \
"

IMAGE_INSTALL_append = " rt-tests grub-efi"

BBMASK += "meta-mortsgna/recipes-defaultconfig/users/unpriv-user_1.2.bb"
BBMASK += "meta-mortsgna/appends/oe-core/base-files_%.bbappend"
```

## meta-bsp/conf/machine/e2000.conf
```bitbake
#@MAINTAINER: chunrong.guo <guochunrong@phytium.com.cn>

require conf/machine/phytium-base.inc
require conf/machine/include/arm/arch-arm64.inc

MACHINEOVERRIDES =. "ft2000:"

UBOOT_DTB_LOADADDRESS = "0x90000000"
UBOOT_ENTRYPOINT = "0x80080000"

UBOOT_MACHINE = "config"
KERNEL_CLASSES  = " kernel-fitimage "
KERNEL_IMAGETYPES = "fitImage"

KERNEL_DEVICETREE ?= "\
    phytium/e2000d-demo-board.dtb \
    phytium/e2000d-miniitx-board.dtb \
    phytium/e2000d-power-board.dtb \
    phytium/e2000q-come-board.dtb \
    phytium/e2000q-demo-board.dtb \ 
    phytium/e2000q-edu-board.dtb  \
    phytium/e2000q-hanwei-board.dtb \
    phytium/e2000q-miniitx-board.dtb \
    phytium/e2000q-vpx-board.dtb \
    phytium/e2000s-demo-board.dtb \
"
KERNEL_DEFCONFIG ?= "phytium_defconfig"

DEF_DEVICETREE = "e2000d-demo-board.dtb e2000s-demo-board.dtb e2000q-demo-board.dtb"
```

## meta-bsp/conf/machine/phytium-base.inc
```bitbake
# common providers of QorIQ targets
PREFERRED_PROVIDER_virtual/kernel ?= "linux-phytium"

SOC_DEFAULT_IMAGE_FSTYPES = "tar.gz ext2.gz.u-boot ext2.gz cpio.gz"
IMAGE_FSTYPES ?= "${SOC_DEFAULT_IMAGE_FSTYPES}"

MACHINE_FEATURES ?= "pci ext2 ext3 serial usbhost alsa touchscreen keyboard"
MACHINE_EXTRA_RRECOMMENDS += "udev-extraconf kernel-modules"

KERNEL_IMAGETYPE ?= "Image"

SERIAL_CONSOLES ?= "115200;ttyS0 115200;ttyS1 115200;ttyAMA1 115200;ttyAMA0"
SERIAL_CONSOLES_CHECK ?= "${SERIAL_CONSOLES}"

# Machines or distros can define which BSP it should use by default. We are
# intending to default for  BSP by default and specific machines or
# DISTROs might change it if need.
#
# Two values are considered valid: mainline
MACHINE_SOCARCH_SUFFIX ?= ""

MACHINE_ARCH_FILTER = "virtual/kernel"

XSERVER ?= "xserver-xorg \
            ${@bb.utils.contains('DISTRO_FEATURES', 'opengl', 'mesa-driver-swrast xserver-xorg-extension-glx', '', d)} \
            xf86-video-fbdev \
            xf86-video-amd \
            xf86-video-ati \
	    xf86-video-modesetting \
"
PREFERRED_VERSION_gstreamer1.0-libav ?= "1.16.0"
PREFERRED_VERSION_xen = "4.15+stableAUTOINC+e25aa9939a"
PREFERRED_VERSION_xen-tools = "4.15+stableAUTOINC+e25aa9939a"
```

## meta-xenomai/conf/layer.conf
```bitbake
# We have a conf and classes directory, add to BBPATH
BBPATH .= ":${LAYERDIR}"

# We have recipes-* directories, add to BBFILES
BBFILES += "${LAYERDIR}/recipes-*/*/*.bb \
	${LAYERDIR}/recipes-*/*/*.bbappend"

BBFILES_raspberrypi3_append = "${LAYERDIR}/rpi3/recipes-*/*/*.bb \
	${LAYERDIR}/rpi3/recipes-*/*/*.bbappend"

BBFILE_COLLECTIONS += "meta-xenomai"
BBFILE_PATTERN_meta-xenomai = "^${LAYERDIR}/"
BBFILE_PRIORITY_meta-xenomai = "6"

LAYERSERIES_COMPAT_meta-xenomai = "dunfell hardknott"
```
